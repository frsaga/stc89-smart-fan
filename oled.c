#include "oled.h"

// OLED写命令
void OLED_WriteCmd(unsigned char cmd)
{
    I2C_Start();
    I2C_SendByte(OLED_ADDRESS);
    I2C_WaitAck();
    I2C_SendByte(OLED_CMD);
    I2C_WaitAck();
    I2C_SendByte(cmd);
    I2C_WaitAck();
    I2C_Stop();
}

// OLED写数据
void OLED_WriteData(unsigned char dat)
{
    I2C_Start();
    I2C_SendByte(OLED_ADDRESS);
    I2C_WaitAck();
    I2C_SendByte(OLED_DATA);
    I2C_WaitAck();
    I2C_SendByte(dat);
    I2C_WaitAck();
    I2C_Stop();
}

// 设置光标位置
void OLED_SetPos(unsigned char x, unsigned char y)
{
    OLED_WriteCmd(0xB0 + y);
    OLED_WriteCmd(((x & 0xF0) >> 4) | 0x10);
    OLED_WriteCmd((x & 0x0F) | 0x01);
}

// OLED初始化
void OLED_Init(void)
{
    I2C_Init();
    
    // 初始化序列
    OLED_WriteCmd(0xAE); // 关闭显示
    OLED_WriteCmd(0xD5); // 设置时钟分频
    OLED_WriteCmd(0x80);
    OLED_WriteCmd(0xA8); // 设置多路复用率
    OLED_WriteCmd(0x3F);
    OLED_WriteCmd(0xD3); // 设置显示偏移
    OLED_WriteCmd(0x00);
    OLED_WriteCmd(0x40); // 设置起始行
    OLED_WriteCmd(0x8D); // 电荷泵设置
    OLED_WriteCmd(0x14);
    OLED_WriteCmd(0x20); // 内存地址模式
    OLED_WriteCmd(0x00);
    OLED_WriteCmd(0xA1); // 段重映射
    OLED_WriteCmd(0xC8); // COM扫描方向
    OLED_WriteCmd(0xDA); // COM引脚配置
    OLED_WriteCmd(0x12);
    OLED_WriteCmd(0x81); // 对比度设置
    OLED_WriteCmd(0xCF);
    OLED_WriteCmd(0xD9); // 预充电周期
    OLED_WriteCmd(0xF1);
    OLED_WriteCmd(0xDB); // VCOMH设置
    OLED_WriteCmd(0x40);
    OLED_WriteCmd(0xA4); // 全局显示开启
    OLED_WriteCmd(0xA6); // 正常显示模式
    OLED_WriteCmd(0xAF); // 开启显示
}

// 清屏
void OLED_Clear(void)
{
    unsigned char i, j;
    for(j = 0; j < 8; j++)
    {
        OLED_SetPos(0, j);
        for(i = 0; i < 128; i++)
        {
            OLED_WriteData(0x00);
        }
    }
}

// 辅助函数：计算幂
static unsigned int OLED_Pow(unsigned char m, unsigned char n)
{
    unsigned int result = 1;
    while(n--)
    {
        result *= m;
    }
    return result;
}

// 6x8字符点阵数据（存储在程序存储器中）
static unsigned char code F6x8[][6] = {
    {0x00, 0x00, 0x00, 0x00, 0x00, 0x00}, // 空格
    {0x00, 0x00, 0x5F, 0x00, 0x00, 0x00}, // !
    {0x00, 0x07, 0x00, 0x07, 0x00, 0x00}, // "
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    {0x61, 0x51, 0x49, 0x45, 0x43, 0x00}, // Z
};

// 显示字符
void OLED_ShowChar(unsigned char x, unsigned char y, unsigned char chr)
{
    unsigned char c = 0, i;
    if(chr >= ' ' && chr <= 'Z')
        c = chr - ' ';
    else
        return;
    
    OLED_SetPos(x, y);
    for(i = 0; i < 6; i++)
    {
        OLED_WriteData(F6x8[c][i]);
    }
}

// 显示字符串
void OLED_ShowString(unsigned char x, unsigned char y, unsigned char *str)
{
    unsigned char j = 0;
    while(str[j] != '\0')
    {
        OLED_ShowChar(x, y, str[j]);
        x += 6;
        if(x > 122)
        {
            x = 0;
            y++;
        }
        j++;
    }
}

// 显示数字
void OLED_ShowNum(unsigned char x, unsigned char y, unsigned int num, unsigned char len)
{
    unsigned char t, temp;
    unsigned char enshow = 0;
    for(t = 0; t < len; t++)
    {
        temp = (num / OLED_Pow(10, len - t - 1)) % 10;
        if(enshow == 0 && t < (len - 1))
        {
            if(temp == 0)
            {
                OLED_ShowChar(x + 6 * t, y, ' ');
                continue;
            }
            else
                enshow = 1;
        }
        OLED_ShowChar(x + 6 * t, y, temp + '0');
    }
}

// 显示有符号数字
void OLED_ShowSignedNum(unsigned char x, unsigned char y, int num, unsigned char len)
{
    unsigned char t, temp;
    unsigned char enshow = 0;
    if(num >= 0)
    {
        OLED_ShowChar(x, y, '+');
    }
    else
    {
        OLED_ShowChar(x, y, '-');
        num = -num;
    }
    for(t = 0; t < len; t++)
    {
        temp = (num / OLED_Pow(10, len - t - 1)) % 10;
        if(enshow == 0 && t < (len - 1))
        {
            if(temp == 0)
            {
                OLED_ShowChar(x + 6 * (t + 1), y, ' ');
                continue;
            }
            else
                enshow = 1;
        }
        OLED_ShowChar(x + 6 * (t + 1), y, temp + '0');
    }
}

// 显示十六进制数字
void OLED_ShowHexNum(unsigned char x, unsigned char y, unsigned int num, unsigned char len)
{
    unsigned char t, temp;
    for(t = 0; t < len; t++)
    {
        temp = (num / OLED_Pow(16, len - t - 1)) % 16;
        if(temp < 10)
            OLED_ShowChar(x + 6 * t, y, temp + '0');
        else
            OLED_ShowChar(x + 6 * t, y, temp - 10 + 'A');
    }
}

// 显示二进制数字
void OLED_ShowBinNum(unsigned char x, unsigned char y, unsigned int num, unsigned char len)
{
    unsigned char t;
    for(t = 0; t < len; t++)
    {
        OLED_ShowChar(x + 6 * t, y, (num / OLED_Pow(2, len - t - 1)) % 2 + '0');
    }
}

